/*
 * Copyright (c) 2022 The ZMK Contributors
 *
 * SPDX-License-Identifier: MIT
 */

#include "nine.dtsi"

&kscan0 {
    input-gpios
        = <&pro_micro 4 (GPIO_ACTIVE_LOW | GPIO_PULL_UP)>  // 0    9
        , <&pro_micro 3 (GPIO_ACTIVE_LOW | GPIO_PULL_UP)>  // 1    10
        , <&pro_micro 2 (GPIO_ACTIVE_LOW | GPIO_PULL_UP)>  // 2    11
        , <&pro_micro 16 (GPIO_ACTIVE_LOW | GPIO_PULL_UP)> // 3    12
        , <&pro_micro 14 (GPIO_ACTIVE_LOW | GPIO_PULL_UP)> // 4    13
        , <&pro_micro 15 (GPIO_ACTIVE_LOW | GPIO_PULL_UP)> // 5    14
        , <&pro_micro 18 (GPIO_ACTIVE_LOW | GPIO_PULL_UP)> // 6    15
        , <&pro_micro 6 (GPIO_ACTIVE_LOW | GPIO_PULL_UP)>  // 7    16
        , <&pro_micro 7 (GPIO_ACTIVE_LOW | GPIO_PULL_UP)>  // 8    17
        ;
};