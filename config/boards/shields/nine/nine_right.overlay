/*
 * Copyright (c) 2020 The ZMK Contributors
 *
 * SPDX-License-Identifier: MIT
 */

#include "nine.dtsi"

&default_transform {
    col-offset = <9>;
};

&kscan0 {
    input-gpios
        = <&pro_micro 19 (GPIO_ACTIVE_LOW | GPIO_PULL_UP)> // 9    18
        , <&pro_micro 20 (GPIO_ACTIVE_LOW | GPIO_PULL_UP)> // 10   19
        , <&pro_micro 21 (GPIO_ACTIVE_LOW | GPIO_PULL_UP)> // 11   20
        , <&pro_micro 8 (GPIO_ACTIVE_LOW | GPIO_PULL_UP)>  // 12   21
        , <&pro_micro 7 (GPIO_ACTIVE_LOW | GPIO_PULL_UP)>  // 8    17
        , <&pro_micro 6 (GPIO_ACTIVE_LOW | GPIO_PULL_UP)>  // 7    16
        , <&pro_micro 5 (GPIO_ACTIVE_LOW | GPIO_PULL_UP)>  // 13   22
        , <&pro_micro 15 (GPIO_ACTIVE_LOW | GPIO_PULL_UP)> // 5    14
        , <&pro_micro 14 (GPIO_ACTIVE_LOW | GPIO_PULL_UP)> // 4    13
        ;
};