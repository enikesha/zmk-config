## config/boards/shields/anisote/Kconfig.defconfig
```kconfig
# Copyright (c) 2022 The ZMK Contributors
# SPDX-License-Identifier: MIT

if SHIELD_ANISOTE

config ZMK_KEYBOARD_NAME
    default "Anisote"

endif
```

## config/boards/shields/anisote/Kconfig.shield
```kconfig
# Copyright (c) 2022 The ZMK Contributors
# SPDX-License-Identifier: MIT

config SHIELD_ANISOTE
    def_bool $(shields_list_contains,anisote)
```

## config/west.yml
```yaml
manifest:
  remotes:
    - name: zmkfirmware
      url-base: https://github.com/zmkfirmware
    - name: petejohanson
      url-base: https://github.com/petejohanson
  projects:
    - name: zmk
      remote: zmkfirmware
      revision: main
      # remote: petejohanson
      # revision: hardware/rp2040-support
      import: app/west.yml
  self:
    path: config
```
